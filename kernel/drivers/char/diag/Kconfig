## kernel/drivers/char/diag/Kconfig
```kconfig
menu "Diag Support"

config DIAG_CHAR
	tristate "char driver interface and diag forwarding to/from modem"
	default m
	depends on USB_ANDROID_DIAG || USB_FUNCTION_DIAG || USB_QCOM_MAEMO
	depends on ARCH_MSM
	help
	 Char driver interface for diag user space and diag-forwarding to modem ARM and back.
	 This enables diagchar for maemo usb gadget or android usb gadget based on config selected.

config DEBUG_STATUS
	bool "Debug status driver for enable/disable debugmode"
	default n
	help
	 None

config QXDM_LOG
	bool "QXDM log reader"
	default n
	help
	 None
endmenu

menu "DIAG traffic over USB"

config DIAG_OVER_USB
	bool "Enable DIAG traffic to go over USB"
        depends on ARCH_MSM
	default y
	help
	 This feature helps segregate code required for DIAG traffic to go over USB.
endmenu

menu "SDIO support for DIAG"

config DIAG_SDIO_PIPE
	depends on MSM_SDIO_AL
	default y
	bool "Enable 9K DIAG traffic over SDIO"
	help
	 SDIO Transport Layer for DIAG Router
endmenu
```

## kernel/drivers/video/msm/Kconfig
```kconfig
source "drivers/video/msm/vidc/Kconfig"

config ENABLE_VSYNC
	bool "Enable VSync (30fps limit)"
	default y

config OVERRIDE_LCD_FREQUENCY
	bool "Change Frequency of the LCD"
	default n
	
config LCD_FREQUENCY_T2
	int "T2 value 245 <= x <= 999"
	depends on OVERRIDE_LCD_FREQUENCY
	default 340
	
config FIX_FPS
	bool "Fix FPS issue"
	depends on !ENABLE_VSYNC
	default n

config FB_MSM
	tristate
	depends on FB && ARCH_MSM
	select FB_CFB_FILLRECT
	select FB_CFB_COPYAREA
	select FB_CFB_IMAGEBLIT
	default y

config FB_MSM_LCDC
	bool "Support for integrated LCD controller in qsd8x50"
	depends on FB_MSM && MSM_MDP31
	default y
```
